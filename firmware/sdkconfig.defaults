## firmware/sdkconfig.defaults
```kconfig
CONFIG_BOOTLOADER_LOG_LEVEL_ERROR=y
CONFIG_ESPTOOLPY_HEADER_FLASHSIZE_UPDATE=y
CONFIG_COMPILER_OPTIMIZATION_PERF=y
CONFIG_BT_ENABLED=y
CONFIG_BT_NIMBLE_ENABLED=y
CONFIG_BT_NIMBLE_LOG_LEVEL_ERROR=y
CONFIG_BT_CTRL_DFT_TX_POWER_LEVEL_P21=y
CONFIG_PM_ENABLE=y
CONFIG_PM_DFS_INIT_AUTO=y
# CONFIG_ESP_DEFAULT_CPU_FREQ_MHZ_80 is not set
CONFIG_ESP_DEFAULT_CPU_FREQ_MHZ_240=y
CONFIG_FREERTOS_TIMER_TASK_STACK_DEPTH=4096
CONFIG_LOG_COLORS=n
CONFIG_LOG_TIMESTAMP_SOURCE_SYSTEM=y
CONFIG_OPENTHREAD_RX_ON_WHEN_IDLE=y
CONFIG_BT_NIMBLE_ATT_PREFERRED_MTU=400
CONFIG_GPIO_CTRL_FUNC_IN_IRAM=y
# CONFIG_BT_NIMBLE_ROLE_CENTRAL is not set
# CONFIG_BT_NIMBLE_ROLE_BROADCASTER is not set
# CONFIG_BT_NIMBLE_ROLE_OBSERVER is not set
```
